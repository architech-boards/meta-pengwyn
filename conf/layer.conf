## conf/layer.conf
```bitbake
# Let bitbake find our .bbclass and .conf files
BBPATH .= ":${LAYERDIR}"

# Let bitbake know where to look for .bb and .bbappend files
BBFILES += "${LAYERDIR}/recipes-*/*/*.bb \
            ${LAYERDIR}/recipes-*/*/*.bbappend"

BBFILE_COLLECTIONS += "pengwyn"
BBFILE_PATTERN_pengwyn := "^${LAYERDIR}/"
BBFILE_PRIORITY_pengwyn = "6"
```

## conf/machine/pengwyn.conf
```bitbake
#@TYPE: Machine
#@NAME: Pengwyn machine
#@DESCRIPTION: Machine configuration for ArchiTech's Pengwyn board

require conf/machine/include/ti33x.inc

IMAGE_FSTYPES += "ubi tar.gz"

SERIAL_CONSOLE = "115200 ttyO0"

PREFERRED_PROVIDER_virtual/kernel       	= "sitara-linux-ti-staging"
PREFERRED_VERSION_sitara-linux-ti-staging	= "3.14.32"

PREFERRED_PROVIDER_virtual/bootloader   	= "u-boot-ti-staging"
PREFERRED_VERSION_u-boot-ti-staging     	= "2014.07"
PREFERRED_PROVIDER_u-boot               	= "u-boot-ti-staging"
UBOOT_MACHINE                           	= "pengwyn_config"

# UBI information.  Note that this is board and kernel specific.  Changes
# in your kernel port may require changes in these variables.  For more
# details about this board please see
# http://processors.wiki.ti.com/index.php/UBIFS_Support

# do ubiattach /dev/ubi_ctrl -m 9 -O 4096
# From dmesg:
# UBI: smallest flash I/O unit:    4096
# UBI: logical eraseblock size:    516096 bytes
# from ubiattach stdout:
# UBI device number 0, total 1988 LEBs
MKUBIFS_ARGS = "-F -m 4096 -e 516096 -c 1988"

# do ubiattach /dev/ubi_ctrl -m 9 -O 4096
# from dmesg:
# UBI: smallest flash I/O unit:    4096
# UBI: physical eraseblock size:   524288 bytes (512 KiB)
# UBI: sub-page size:              4096
# UBI: VID header offset:          4096 (aligned 4096)
UBINIZE_ARGS = "-m 4096 -p 512KiB -s 4096 -O 4096"
```
